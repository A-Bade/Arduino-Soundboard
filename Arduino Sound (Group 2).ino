#include <PCM.h>

const unsigned char mario[] PROGMEM = {126, 126, 127, 127, 126, 126, 126, 127, 127, 128, 128, 127, 127,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 146, };

const unsigned char discord[] PROGMEM = 
{129, 129, 129, 129, 128, 127, 126, 125, 125, 125, 126, 127, 129,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 128, };
const unsigned char nice[] PROGMEM = 
{129, 129, 129, 129, 129, 129, 128, 128, 128, 128, 127, 127, 127,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 126, };
const unsigned char hello[] PROGMEM =
{125, 121, 118, 118, 120, 124, 130, 134, 136, 135, 132, 129, 127,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 244, };
const unsigned char sans[] PROGMEM = 
{126, 126, 127, 127, 128, 128, 128, 128, 129, 129, 128, 128, 128,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 113, };

const int F = 2;
const int G = 3;
const int H = 4;
const int I = 5;
const int J = 6;

const int Speak = 11;

void setup()
{
  pinMode(F, INPUT);
  digitalWrite(F,HIGH);

  pinMode(G, INPUT);
  digitalWrite(G,HIGH);
  
  pinMode(H, INPUT);
  digitalWrite(H,HIGH);

  pinMode(I, INPUT);
  digitalWrite(I,HIGH);
  
  pinMode(J, INPUT);
  digitalWrite(J,HIGH);
}
void loop()
{
  while(digitalRead(F) == LOW)
  {
    startPlayback(discord, sizeof(discord));
    delay(750);
  }
  while(digitalRead(G) == LOW)
  {
    startPlayback(nice, sizeof(nice));
    delay(1000);
  }
  while(digitalRead(H) == LOW)
  {
    startPlayback(hello, sizeof(hello));
    delay(1200);
  }
  while(digitalRead(I) == LOW)
  {
     startPlayback(sans, sizeof(sans));
     delay(750);
  }
  while(digitalRead(J) == LOW)
  {
    startPlayback(mario, sizeof(mario));
    delay(750);
  }
  noTone(Speak);
}





