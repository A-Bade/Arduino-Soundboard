#include <PCM.h>

const unsigned char nope[] PROGMEM = {126, 126, 125, 125, 125, 125, 125, 125, 125, 125, 125, 126, 126,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 117, };

const unsigned char win_shut[] PROGMEM = 
{126, 127, 128, 127, 128, 126, 128, 128, 128, 128, 127, 128, 127,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 134, };
const unsigned char oof[] PROGMEM = 
{126, 126, 127, 128, 128, 128, 127, 127, 128, 129, 129, 128, 127,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 133, };
const unsigned char yeet[] PROGMEM =
{126, 127, 127, 127, 127, 127, 128, 128, 128, 127, 128, 129, 128,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 128, };
const unsigned char bruh[] PROGMEM = 
{134, 140, 138, 139, 141, 139, 137, 137, 137, 134, 133, 134, 133,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 116, };

const int A = 2;
const int B = 3;
const int C = 4;
const int D = 5;
const int E = 6;

const int Buzz = 11;

void setup()
{
  pinMode(A, INPUT);
  digitalWrite(A,HIGH);

  pinMode(B, INPUT);
  digitalWrite(B,HIGH);
  
  pinMode(C, INPUT);
  digitalWrite(C,HIGH);

  pinMode(D, INPUT);
  digitalWrite(D,HIGH);
  
  pinMode(E, INPUT);
  digitalWrite(E,HIGH);
}
void loop()
{
  while(digitalRead(A) == LOW)
  {
    startPlayback(win_shut, sizeof(win_shut));
    delay(1750);
  }
  while(digitalRead(B) == LOW)
  {
    startPlayback(oof, sizeof(oof));
    delay(750);
  }
  while(digitalRead(C) == LOW)
  {
    startPlayback(yeet, sizeof(yeet));
    delay(750);
  }
  while(digitalRead(D) == LOW)
  {
     startPlayback(bruh, sizeof(bruh));
     delay(750);
  }
  while(digitalRead(E) == LOW)
  {
    startPlayback(nope, sizeof(nope));
    delay(750);
  }
  noTone(Buzz);
}